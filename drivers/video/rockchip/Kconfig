## drivers/video/rockchip/mpp/Kconfig
```kconfig
# SPDX-License-Identifier: (GPL-2.0+ OR MIT)
#
# Rockchip MPP (Media Process Platform) service framework,
# ported from the Rockchip BSP kernel to mainline.
#

menuconfig ROCKCHIP_MPP_SERVICE
	tristate "mpp service framework"
	depends on ARCH_ROCKCHIP
	help
	  Rockchip MPP service framework. This brings up /dev/mpp_service
	  which is used by the Rockchip userspace MPP library
	  (librockchip_mpp / ffmpeg-rockchip).

if ROCKCHIP_MPP_SERVICE

config ROCKCHIP_MPP_PROC_FS
	bool "mpp service procfs"
	depends on PROC_FS
	default y
	help
	  Rockchip mpp service procfs.

config ROCKCHIP_MPP_RKVDEC
	bool "RKV decoder device driver"
	help
	  Rockchip mpp rkv combo decoder (H.264/H.265/VP9), aka RKVDEC.
	  This is the 4K video decoder found on RK3399.

config ROCKCHIP_MPP_VDPU2
	bool "VPU decoder v2 device driver"
	help
	  Rockchip mpp vpu decoder v2 (Hantro G1).

config ROCKCHIP_MPP_VEPU2
	bool "VPU encoder v2 device driver"
	help
	  Rockchip mpp vpu encoder v2 (Hantro H1).

endif
```

## drivers/video/rockchip/rga2/Kconfig
```kconfig
# SPDX-License-Identifier: GPL-2.0
menuconfig ROCKCHIP_RGA2
	tristate "RGA2 (Rockchip 2D graphics accelerator)"
	depends on ARCH_ROCKCHIP
	help
	  Rockchip RGA2 2D graphics accelerator driver (BSP / librga ABI).
	  This is the Rockchip BSP driver exposing /dev/rga with the ioctl
	  interface expected by librga, as an alternative to the V4L2 based
	  upstream driver in drivers/media/platform/rockchip/rga.

	  Say Y here to build the BSP RGA2 driver. If unsure, say N.

if ROCKCHIP_RGA2

config ROCKCHIP_RGA2_PROC_FS
	bool "Enable RGA2 procfs"
	select ROCKCHIP_RGA2_DEBUGGER
	depends on PROC_FS
	help
	  Enable procfs to debug RGA driver.

config ROCKCHIP_RGA2_DEBUG_FS
	bool "Enable RGA2 debugfs"
	select ROCKCHIP_RGA2_DEBUGGER
	depends on DEBUG_FS
	default y
	help
	  Enable debugfs to debug RGA driver.

config ROCKCHIP_RGA2_DEBUGGER
	bool
	help
	  Enabling the debugger of RGA2, you can use procfs and debugfs for debugging.

endif
```
