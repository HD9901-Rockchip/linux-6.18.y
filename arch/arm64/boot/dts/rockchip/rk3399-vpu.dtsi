/*
 * Copyright (c) 2021 Rockchip Electronics Co., Ltd.
 */

/ {
	rockchip_system_monitor: rockchip-system-monitor {
		compatible = "rockchip,system-monitor";

		rockchip,thermal-zone = "cpu-thermal";
		status = "disabled";
	};

	sram: sram@ff8d0000 {
		compatible = "mmio-sram";
		reg = <0x0 0xff8d0000 0x0 0x20000>;
	};
};

/*
 * Enable the Rockchip BSP media stack (mpp_service + vepu/vdpu/rkvdec/rga2).
 * It replaces the upstream Hantro VPU, stateless rkvdec and V4L2 RGA drivers,
 * which claim the same hardware.
 */
#include "rk3399-mpp.dtsi"
